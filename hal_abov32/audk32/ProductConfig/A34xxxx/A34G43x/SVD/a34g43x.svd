# a34g43x register map
Vendor: ABOV Semiconductor Co., Ltd.; File version: 1.0
ARM 32-bit Cortex-M4F Microcontroller based device, CPU clock up to 200MHz, etc.
CPU: CM4 r0p1, little endian, MPU, FPU, VTOR, 4 interrupt priority bits
Registers are 32-bit, read-write, reset 0x0 unless marked. A register's access mark holds for its fields unless they carry their own. Offsets are from the block's base; lines under a group give offsets from that group; [hi:lo] are bit positions; {n}, {i} and the like mark numbered series; 'fields as' and 'values as' point back to an identical list; <NAME> marks a mode.

## Memory map
0x40000000 SCU size 0x140 — System Control Unit
0x400000FC CHIPCONFIG2 size 0x4 — Chip Configuration Data 2
0x40000200 WDT size 0x100 — WATCH-DOG TIMER
{0x40000400+0x10*n} DMA{n} size 0x10 (n=0..15)
0x40000500 AES128 size 0x100 — Advanced Encryption Standard 128
0x40000600 FRT0 size 0x100
0x40000700 FRT1 size 0x100
0x40000A00 RNG size 0x100 — Random Number Generator
0x40002000 PWM0 size 0x1C
0x40002020 PWM1 size 0x1C
0x40002040 PWM2 size 0x1C
0x40002060 PWM3 size 0x1C
0x40002080 PWM4 size 0x1C
0x400020A0 PWMPRS0 size 0x4
0x40002100 PWM5 size 0x1C
0x40002120 PWM6 size 0x1C
0x40002140 PWM7 size 0x1C
0x40002160 PWM8 size 0x1C
0x40002180 PWM9 size 0x1C
0x400021A0 PWMPRS1 size 0x4
{0x40003000+0x40*n} TIMER{n} size 0x40 (n=0..9)
{0x40008000+0x100*n} UART{n} size 0x100 (n=0..12)
{0x40009000+0x100*n} SPI{n} size 0x100 (n=0..11)
0x4000A000 I2C0 size 0x100
0x4000A100 I2C1 size 0x100
0x4000A200 I2C2 size 0x100
0x4000A300 I2C3 size 0x100
0x4000B380 CMP0 size 0xC
0x4000B390 CMP1 size 0xC
0x4000B3A0 CMP2 size 0xC
0x4000B3B0 CMP3 size 0xC
0x4000B600 DAC0 size 0x100
0x4000B700 DAC1 size 0x100
0x4000F000 CHIPCONFIG size 0x10 — Chip Configuration Data
0x40010000 CANFD0 size 0x1100 — CAN with Flexible Data Rate (CANFD)
0x40012000 CANFD1 size 0x1100
0x40020000 QSPI size 0x200 — Serial Peripheral Interface Bus
0x41000000 CFMC size 0x1000 — CODE FLASH MEMORY CONTROLLER
0x41001000 DFMC size 0x1000 — DATA FLASH MEMORY CONTROLLER
0x41002000 CRC size 0x1000 — CYCLIC REDUNDANCY CHECK AND CHECKSUM
0x41010000 PA size 0x100
0x41010100 PB size 0x100
0x41010200 PC size 0x100
0x41010300 PD size 0x100
0x41010400 PE size 0x100
0x41010500 PF size 0x100
0x41010600 PG size 0x100
0x41010F0C RSTDB size 0xF — Pin Reset Debounce Control
0x41010FF0 PORTEN size 0xF — General Port Access Enable
0x41012000 ADC0 size 0x100
0x41012100 ADC1 size 0x100
0x41012200 ADC2 size 0x100
0x41014000 MPWM0 size 0x100 — Motor Pulse Width Modulation
0x41014100 MPWM1 size 0x100
0x50000400 DMA size 0x10 — Direct Memory Access Control
0x50000600 FRT size 0x100 — Free Run Timer
0x50002000 PWM size 0x1C — PWM Generator
0x500020A0 PWMPRS size 0x4
0x50003000 TIMER size 0x40 — TIMER COUNTER
0x50008000 UART size 0x100 — Universal Asynchronous Receiver/Transmitter
0x50009000 SPI size 0x100 — Serial Peripheral Interface Bus
0x5000A000 I2C size 0x100 — Inter-Integrated Circuit
0x5000B380 CMP size 0xC — Comparator
0x5000B600 DAC size 0x100 — Digital-to-Analog Converter
0x51010000 PCU size 0x100 — General Port
0x51012000 ADC size 0x100 — 12-BIT A/D CONVERTER

## Interrupts
0 LVI (SCU)
1 SYSCLKFAIL (SCU)
2 HSEFAIL (SCU)
3 LSEFAIL (SCU)
6 WDT
8 FRT0
9 FRT1
11 CFMC
12 DFMC
{n+15} TIMER{n} (n=0..9)
27 RNG
28 AES128
36 GPIOA (PA)
37 GPIOB (PB)
38 GPIOC (PC)
39 GPIOD (PD)
40 GPIOE (PE)
41 GPIOF (PF)
42 GPIOG (PG)
45 MPWM0PROT (MPWM0)
46 MPWM0OC (MPWM0)
47 MPWM0
50 MPWM1PROT (MPWM1)
51 MPWM1OC (MPWM1)
52 MPWM1
55 SPI0
56 SPI1
57 SPI2
60 I2C0
61 I2C1
62 I2C2
63 UART0
64 UART1
65 UART2
66 UART3
67 UART4
68 UART5
71 CANFD0
72 CANFD1
74 ADC0
75 ADC1
76 ADC2
79 CMP0
80 CMP1
81 CMP2
82 CMP3
85 CRC
{n+88} PWM{n} (n=0..9)
100 I2C3
104 QSPI
108 UART6
109 UART7
110 UART8
111 UART9
112 UART10
113 UART11
114 UART12
{n+113} SPI{n} (n=3..11)

## CHIPCONFIG — Chip Configuration Data
Base 0x4000F000
0x00 VENDORID ro reset 0x41424F56
0x04 CHIPID ro
0x08 REVNR ro — Revision Number Register

## CHIPCONFIG2 — Chip Configuration Data 2
Base 0x400000FC
0x00 CHIPID2 ro
